## board/mrd/mx6tslogger/Kconfig
```kconfig
if TARGET_MX6TSLOGGER

config SYS_BOARD
	default "mx6tslogger"

config SYS_VENDOR
	default "mrd"

config SYS_CONFIG_NAME
	default "mx6tslogger"

endif
```

## configs/mx6dltslogger_defconfig
```kconfig
CONFIG_ARM=y
CONFIG_ARCH_MX6=y
CONFIG_TARGET_MX6TSLOGGER=y
CONFIG_SYS_EXTRA_OPTIONS="IMX_CONFIG=board/mrd/mx6tslogger/mx6dltslogger.cfg,MX6DL"
# CONFIG_CMD_IMLS is not set
# CONFIG_CMD_FLASH is not set
CONFIG_SPI_FLASH=y
```
